#include <PCM.h>

// ---- Thresholds ----
#define DISTANCE_CM_THRESHOLD 120  // min distance in cm that is considered as presence
#define PRESENCE_DETECTION_INTERVAL 60 // ms betweeen presence detection probes
#define PRESENCE_CONFIDENCE_THRESHOLD 3// how often presence must be detected in a row to be considered as confident presence
#define MIN_LAUGH_PAUSE 30000 // pause in s that is enforced between MAX_LAUGHS_IN_A ROW
#define MAX_LAUGHS_IN_A_ROW 3 // max laughs in a row w/o a pause
#define MAX_CANDLE_UPDATE_INTERVAL 100 // max ms between candle LED updates 


// ---- Pins ----
#define TRIGGER_PIN 7
#define ECHO_PIN 8
// The CANDLE LEDs must be connected to PWM Pins!
// Arduino Ethernet: 3,5,6,9 and 10 are PWM Pins!
// The PCM lib breaks analogWrite() for Pins 3,9,10 and 11!
#define RED_CANDLE_LED_PIN  6  
#define YELLOW_CANDLE_LED_PIN 5
#define RED_LEDS_PIN 4  
#define PIEZO_PIN 11

// ---- Sounds ----
#define SAMPLE_LEN 1800
const unsigned char sample[] PROGMEM = {
126, 127, 128, 127, 127, 127, 127, 128, 129, 126, 126, 129,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 124, 
};


unsigned long nextLEDChange = 0;
unsigned long nextDetectionProbe = 0;
unsigned long nextSampleEnd = 0;

unsigned long presenceConfidenceCounter = 0;
unsigned long laughCounter = 0;
unsigned long lastLaugh = 0;

boolean presence = false;

void setup(){
  noTone(PIEZO_PIN);
  pinMode(TRIGGER_PIN, OUTPUT); 
  pinMode(ECHO_PIN, INPUT); 
  pinMode(RED_LEDS_PIN, OUTPUT); 
  pinMode(RED_CANDLE_LED_PIN, OUTPUT); 
  pinMode(YELLOW_CANDLE_LED_PIN, OUTPUT); 
  Serial.begin(9600);
}

void loop()
{
  if(laughCounter > 0 && millis() - lastLaugh >= MIN_LAUGH_PAUSE)
  {
      laughCounter = 0;
  }  
 
  if(laughCounter < MAX_LAUGHS_IN_A_ROW && detectPresence())
  {
      ledDanger();
      laughCounter++;
      laugh();      
  } else {
      ledCandle();    
  }  
}  

boolean detectPresence()
{
  
  unsigned long currentMillis = millis();
  if(currentMillis < nextDetectionProbe)
  {
    return presence;
  }

  if(getDistanceInCm() > DISTANCE_CM_THRESHOLD)
  {
      presenceConfidenceCounter = 0;
      presence = false;
  } else {
      presenceConfidenceCounter++;
      if(presenceConfidenceCounter<PRESENCE_CONFIDENCE_THRESHOLD){
        presence = false;
      } else { 
        presence = true;
        presenceConfidenceCounter=0;
      }
  }    
  
  nextDetectionProbe = currentMillis + PRESENCE_DETECTION_INTERVAL;
  return presence;
}  

long getDistanceInCm()
{
   digitalWrite(TRIGGER_PIN, LOW); 
   delayMicroseconds(2); 
   digitalWrite(TRIGGER_PIN, HIGH);
   delayMicroseconds(10); 
   digitalWrite(TRIGGER_PIN, LOW);

   long duration = pulseIn(ECHO_PIN, HIGH);
   long distance = duration/58.2;

   Serial.println(distance); 
   return distance;

}  

void laugh()
{
      Serial.print("Play[");
      Serial.print(laughCounter);
      Serial.println("] ...");
      startPlayback(sample, sizeof(sample));
      delay(SAMPLE_LEN);
      Serial.println("Stop ...");      
      stopPlayback();
      
      lastLaugh = millis();;
}  

void releaseSound()
{
  stopPlayback();
}  

void ledCandle()
{
    digitalWrite(RED_LEDS_PIN, LOW);
   
    unsigned long currentMillis = millis();
    if(currentMillis > nextLEDChange)
    {
	analogWrite(RED_CANDLE_LED_PIN, random(80,255));
	analogWrite(YELLOW_CANDLE_LED_PIN, random(80,255));
	nextLEDChange = currentMillis + random(MAX_CANDLE_UPDATE_INTERVAL);
    }
}  

void ledDanger()
{
      digitalWrite(RED_LEDS_PIN, HIGH);
      digitalWrite(RED_CANDLE_LED_PIN, HIGH);
      digitalWrite(YELLOW_CANDLE_LED_PIN, LOW);
}  


